/*
 * Copyright (c) 2022 Duccio Breschi
 *
 * SPDX-License-Identifier: MIT
 */

#include "openwork36.dtsi"


&kscan0 {
    diode-direction = "col2row";
    col-gpios
       = <&pro_micro 10(GPIO_ACTIVE_HIGH)> // COL5
    ;
};
