#include "cake.dtsi"

/ {
   chosen {
      zmk,kscan = &mock_kscan;
   };

   mock_kscan: kscan_0 {
      compatible = "zmk,kscan-mock";
      columns = <0>;
      rows = <0>;
      events = <0>;
   };
};

&kscan0 {
    diode-direction = "col2row";
    col-gpios
        = <&pro_micro 20 (GPIO_ACTIVE_HIGH)> // COL1
        , <&pro_micro 10 (GPIO_ACTIVE_HIGH)> // COL2
        , <&pro_micro 6 (GPIO_ACTIVE_HIGH)> // COL3
	    , <&pro_micro 7 (GPIO_ACTIVE_HIGH)> // COL4
        , <&pro_micro 8 (GPIO_ACTIVE_HIGH)> // COL5
    ;
};