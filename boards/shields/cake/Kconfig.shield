## boards/shields/cake/Kconfig.shield
```kconfig
config SHIELD_CAKE_DONGLE
    def_bool $(shields_list_contains,cake_dongle)

config SHIELD_CAKE_LEFT
    def_bool $(shields_list_contains,cake_left)

config SHIELD_CAKE_RIGHT
    def_bool $(shields_list_contains,cake_right)
```

## boards/shields/corne_tp/Kconfig.defconfig
```kconfig
# Central Side Configuration
#
# The side on which the PS/2 mouse is connected MUST be the central side.
#
# By default zmk configures the LEFT side as the central side. But most people
# want to connect their pointing devices to the RIGHT side.
#
# So, you need to define that the central side is the one to which the
# pointing device is connected to.

if SHIELD_CORNE_TP_RIGHT

config ZMK_KEYBOARD_NAME
    default "Corne TP"

config ZMK_SPLIT_ROLE_CENTRAL
    default y

endif

# Options that should be enabled on both sides
if SHIELD_CORNE_TP_LEFT || SHIELD_CORNE_TP_RIGHT

config ZMK_SPLIT
    default y

endif
```

## config/boards/shields/cake/Kconfig.defconfig
```kconfig
if SHIELD_CAKE_DONGLE

config ZMK_KEYBOARD_NAME
    default "cake36"

config ZMK_SPLIT_ROLE_CENTRAL
    default y

config ZMK_SPLIT_BLE_CENTRAL_PERIPHERALS
    default 2

endif

if SHIELD_CAKE_DONGLE || SHIELD_CAKE_LEFT || SHIELD_CAKE_RIGHT

config ZMK_SPLIT
    default y

endif
```

## config/boards/shields/chary/Kconfig.defconfig
```kconfig
# Copyright (c) 2022 Duccio Breschi
# SPDX-License-Identifier: MIT

if SHIELD_CHARY_RIGHT

config ZMK_KEYBOARD_NAME
    default "Chary"

config ZMK_SPLIT_ROLE_CENTRAL
    default y

endif

if SHIELD_CHARY_LEFT || SHIELD_CHARY_RIGHT

config ZMK_SPLIT
    default y

endif
```

## config/boards/shields/chary/Kconfig.shield
```kconfig
# Copyright (c) 2022 Duccio Breschi
# SPDX-License-Identifier: MIT

config SHIELD_CHARY_LEFT
    def_bool $(shields_list_contains,chary_left)

config SHIELD_CHARY_RIGHT
    def_bool $(shields_list_contains,chary_right)
```

## config/boards/shields/charybdis/Kconfig.shield
```kconfig
# Copyright (c) 2022 Duccio Breschi
# SPDX-License-Identifier: MIT

config SHIELD_CHARYBDIS_LEFT
    def_bool $(shields_list_contains,charybdis_left)

config SHIELD_CHARYBDIS_RIGHT
    def_bool $(shields_list_contains,charybdis_right)
```

## config/boards/shields/kafka/Kconfig.defconfig
```kconfig
# Copyright (c) 2022 Duccio Breschi
# SPDX-License-Identifier: MIT

if SHIELD_OPENWORK36_LEFT

config ZMK_KEYBOARD_NAME
    default "kafka46"

config ZMK_SPLIT_ROLE_CENTRAL
    default y

endif

if SHIELD_OPENWORK36_LEFT || SHIELD_OPENWORK36_RIGHT

config ZMK_SPLIT
    default y

endif
```

## config/boards/shields/kafka/Kconfig.shield
```kconfig
# Copyright (c) 2022 Duccio Breschi
# SPDX-License-Identifier: MIT

config SHIELD_OPENWORK36_LEFT
    def_bool $(shields_list_contains,openwork36_left)

config SHIELD_OPENWORK36_RIGHT
    def_bool $(shields_list_contains,openwork36_right)
```

## config/west.yml
```yaml
manifest:
  remotes:
    - name: zmkfirmware
      url-base: https://github.com/zmkfirmware
    - name: cirque-input-module
      url-base: https://github.com/petejohanson
  projects:
    - name: zmk
      remote: zmkfirmware
      revision: main
      import: app/west.yml
    - name: cirque-input-module
      remote: cirque-input-module
      revision: main
  self:
    path: config
```
